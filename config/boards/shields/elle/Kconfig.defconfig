## config/boards/shields/elle/Kconfig.defconfig
```kconfig
if SHIELD_ELLE_DONGLE

config ZMK_KEYBOARD_NAME
	default "Elle"
	
config ZMK_SPLIT_ROLE_CENTRAL
	default y
	
endif

if SHIELD_ELLE_LEFT || SHIELD_ELLE_RIGHT || SHIELD_ELLE_DONGLE 

config ZMK_SPLIT
	default y
	
endif
```

## config/boards/shields/elle/Kconfig.shield
```kconfig
config SHIELD_ELLE_LEFT
	def_bool $(shields_list_contains,elle_left)

config SHIELD_ELLE_RIGHT
	def_bool $(shields_list_contains,elle_right)

config SHIELD_ELLE_DONGLE
	def_bool $(shields_list_contains,elle_dongle)
```
